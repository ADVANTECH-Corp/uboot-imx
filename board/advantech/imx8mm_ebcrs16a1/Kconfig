## board/advantech/imx8mm_ebcrs16a1/Kconfig
```kconfig
if TARGET_IMX8MM_EBCRS16A1_2G

config SYS_BOARD
	default "imx8mm_ebcrs16a1"

config SYS_VENDOR
	default "advantech"

config SYS_CONFIG_NAME
	default "imx8mm_ebcrs16"

config IMX_CONFIG
	default "board/advantech/imx8mm_ebcrs16a1/imximage-8mm.cfg"

config IMX8M_1G_MEMORY
	bool "imx8m 1GB memory size"

source "board/advantech/common/Kconfig"

endif
```

## board/advantech/imx8mm_rsb3730a2/Kconfig
```kconfig
if TARGET_IMX8MM_RSB3730A2_2G || TARGET_IMX8MM_RSB3730A2_4G

config SYS_BOARD
	default "imx8mm_rsb3730a2"

config SYS_VENDOR
	default "advantech"

config SYS_CONFIG_NAME
	default "imx8mm_rsb3730"

config IMX_CONFIG
	default "board/advantech/imx8mm_rsb3730a2/imximage-8mm.cfg"

config IMX8M_1G_MEMORY
	bool "imx8m 1GB memory size"

source "board/advantech/common/Kconfig"

endif
```

## board/advantech/imx93_afee420a1/Kconfig
```kconfig
if TARGET_IMX93_AFEE420A1

config SYS_BOARD
	default "imx93_afee420a1"

config SYS_VENDOR
	default "advantech"

config SYS_CONFIG_NAME
	default "imx93_afee420"

config IMX93_AFEE420A1_LPDDR4X
	bool "Using LPDDR4X Timing and PMIC voltage"
	default y
	select IMX9_LPDDR4X
	help
	  Select the LPDDR4X timing and 0.6V VDDQ

endif
```

## board/advantech/imx93_rom2820a1/Kconfig
```kconfig
if TARGET_IMX93_ROM2820A1

config SYS_BOARD
	default "imx93_rom2820a1"

config SYS_VENDOR
	default "advantech"

config SYS_CONFIG_NAME
	default "imx93_rom2820"

config IMX93_ROM2820A1_LPDDR4X
	bool "Using LPDDR4X Timing and PMIC voltage"
	default y
	select IMX9_LPDDR4X
	help
	  Select the LPDDR4X timing and 0.6V VDDQ

endif
```

## board/advantech/imx95_aom5521a1/Kconfig
```kconfig
if TARGET_IMX95_AOM5521A1_8G

config SYS_BOARD
	default "imx95_aom5521a1"

config SYS_VENDOR
	default "advantech"

config SYS_CONFIG_NAME
	default "imx95_aom5521"

endif
```

## board/advantech/imx95_aom5521a2/Kconfig
```kconfig
if TARGET_IMX95_AOM5521A2_8G

config SYS_BOARD
	default "imx95_aom5521a2"

config SYS_VENDOR
	default "advantech"

config SYS_CONFIG_NAME
	default "imx95_aom5521"

endif
```
