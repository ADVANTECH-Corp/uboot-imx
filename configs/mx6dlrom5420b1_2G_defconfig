## configs/mx6dlrom5420b1_2G_defconfig
```kconfig
CONFIG_SPL=y
CONFIG_SYS_EXTRA_OPTIONS="IMX_CONFIG=board/freescale/mx6advantech/mx6dlrom5420b1_4x_IM4G16D3FABG-125_1410025137-01.cfg,SPL,MX6DL,SYS_USE_SPINOR"
CONFIG_ARM=y
CONFIG_ARCH_MX6=y
CONFIG_TARGET_MX6ROM5420B1_2G=y
CONFIG_CMD_GPIO=y
```

## configs/mx6dlrsb3430a1_1G_defconfig
```kconfig
CONFIG_SPL=y
CONFIG_SYS_EXTRA_OPTIONS="IMX_CONFIG=board/freescale/mx6advantech/mx6qrsb3430a1_4x_MT41K128M16JT-125_1410022609-01.cfg,SPL,MX6DL,SYS_USE_SPINOR"
CONFIG_ARM=y
CONFIG_ARCH_MX6=y
CONFIG_TARGET_MX6RSB3430A1_1G=y
CONFIG_CMD_GPIO=y
```

## configs/mx6dlubc220a1_1G_defconfig
```kconfig
CONFIG_SYS_EXTRA_OPTIONS="IMX_CONFIG=board/freescale/mx6advantech/mx6dlubc220_4x_K4B2G1646Q-BCK0_1410024420-01.cfg,MX6DL,SYS_USE_SPINOR"
CONFIG_ARM=y
CONFIG_ARCH_MX6=y
CONFIG_TARGET_MX6UBC220A1_1G=y
CONFIG_CMD_GPIO=y
```

## configs/mx6dlubc220a1android_1G_defconfig
```kconfig
CONFIG_SYS_EXTRA_OPTIONS="IMX_CONFIG=board/freescale/mx6advantech/mx6dlubc220a1_4x_K4B2G1646Q-BCK0_1410024420-01.cfg,MX6DL,SYS_USE_SPINOR,ANDROID_SUPPORT"
CONFIG_ARM=y
CONFIG_TARGET_MX6UBC220A1_1G=y
CONFIG_SYS_MALLOC_F=y
CONFIG_SYS_MALLOC_F_LEN=0x400
CONFIG_DM=y
CONFIG_DM_THERMAL=y
```

## configs/mx6qebcgf66a1_2G_defconfig
```kconfig
CONFIG_SPL=y
CONFIG_SYS_EXTRA_OPTIONS="IMX_CONFIG=board/freescale/mx6advantech/mx6qebcgf66_4x_MT41K256M16TW-107_1410026783-01.cfg,SPL,MX6Q,SYS_USE_SPINOR"
CONFIG_ARM=y
CONFIG_ARCH_MX6=y
CONFIG_TARGET_MX6EBCGF66A1_2G=y
CONFIG_CMD_GPIO=y
```

## configs/mx6qprom7421a1_1G_defconfig
```kconfig
CONFIG_SYS_EXTRA_OPTIONS="IMX_CONFIG=board/freescale/mx6advantech/mx6qprom7421a1_4x_MT41K128M16JT-125_1410022609-01.cfg,MX6QP"
CONFIG_ARM=y
CONFIG_TARGET_MX6ROM7421A1_1G=y
CONFIG_SYS_MALLOC_F=y
CONFIG_SYS_MALLOC_F_LEN=0x400
CONFIG_DM=y
CONFIG_DM_THERMAL=y
```

## configs/mx6qprom7421a1_2G_defconfig
```kconfig
CONFIG_SPL=y
CONFIG_SYS_EXTRA_OPTIONS="IMX_CONFIG=board/freescale/mx6advantech/mx6qprom7421a1_4x_IM4G16D3FABG-125_1410025137-01.cfg,SPL,MX6QP,SYS_USE_SPINOR"
CONFIG_ARM=y
CONFIG_TARGET_MX6ROM7421A1_2G=y
CONFIG_SYS_MALLOC_F=y
CONFIG_SYS_MALLOC_F_LEN=0x400
CONFIG_DM=y
CONFIG_DM_THERMAL=y
```

## configs/mx6qrom3420a1_2G_defconfig
```kconfig
CONFIG_SYS_EXTRA_OPTIONS="IMX_CONFIG=board/freescale/mx6advantech/mx6qrom3420a1_4x_IM4G16D3FABG-125_1410025137-01.cfg,MX6Q,SYS_USE_SPINOR"
CONFIG_ARM=y
CONFIG_TARGET_MX6ROM3420A1_2G=y
CONFIG_DM=y
CONFIG_DM_THERMAL=y
```

## configs/mx6qrom7420a1_2G_defconfig
```kconfig
CONFIG_SPL=y
CONFIG_SYS_EXTRA_OPTIONS="IMX_CONFIG=board/freescale/mx6advantech/mx6qrom7420_4x_IM4G16D3FABG-125_1410025137-01.cfg,SPL,MX6Q,SYS_USE_SPINOR"
CONFIG_ARM=y
CONFIG_TARGET_MX6ROM7420A1_2G=y
CONFIG_DM=y
CONFIG_DM_THERMAL=y
```

## configs/mx6qrsb3430a1_1G_defconfig
```kconfig
CONFIG_SPL=y
CONFIG_SYS_EXTRA_OPTIONS="IMX_CONFIG=board/freescale/mx6advantech/mx6qrsb3430a1_4x_MT41K128M16JT-125_1410022609-01.cfg,SPL,MX6Q,SYS_USE_SPINOR"
CONFIG_ARM=y
CONFIG_TARGET_MX6RSB3430A1_1G=y
CONFIG_DM=y
CONFIG_DM_THERMAL=y
```

## configs/mx6qrsb3430a1android_1G_defconfig
```kconfig
CONFIG_SYS_EXTRA_OPTIONS="IMX_CONFIG=board/freescale/mx6advantech/mx6qrsb3430a1_4x_MT41K128M16JT-125_1410022609-01.cfg,MX6Q,SYS_USE_SPINOR,ANDROID_SUPPORT"
CONFIG_ARM=y
CONFIG_TARGET_MX6RSB3430A1_1G=y
CONFIG_DM=y
CONFIG_DM_THERMAL=y
```

## configs/mx6qrsb4410a2_1G_defconfig
```kconfig
CONFIG_SYS_EXTRA_OPTIONS="IMX_CONFIG=board/freescale/mx6advantech/mx6qrsb4410_4x_K4B2G1646Q-BCK0_1410024420-01.cfg,MX6Q,SYS_USE_SPINOR"
CONFIG_ARM=y
CONFIG_ARCH_MX6=y
CONFIG_TARGET_MX6RSB4410A2_1G=y
CONFIG_CMD_GPIO=y
```

## configs/mx6qrsb4410a2android_1G_defconfig
```kconfig
CONFIG_SYS_EXTRA_OPTIONS="IMX_CONFIG=board/freescale/mx6advantech/mx6qrsb4410_4x_K4B2G1646Q-BCK0_1410024420-01.cfg,MX6Q,SYS_USE_SPINOR,ANDROID_SUPPORT"
CONFIG_ARM=y
CONFIG_TARGET_MX6RSB4410A2_1G=y
CONFIG_DM=y
CONFIG_DM_THERMAL=y
```

## configs/mx6qrsb4411a1_2G_defconfig
```kconfig
CONFIG_SPL=y
CONFIG_SYS_EXTRA_OPTIONS="IMX_CONFIG=board/freescale/mx6advantech/mx6qrsb4411a1_4x_IM4G16D3FABG-125_1410025137-01.cfg,SPL,MX6Q,SYS_USE_SPINOR"
CONFIG_ARM=y
CONFIG_ARCH_MX6=y
CONFIG_TARGET_MX6RSB4411A1_2G=y
CONFIG_CMD_GPIO=y
```

## configs/mx6qrsb4411a1android_1G_defconfig
```kconfig
CONFIG_ARM=y
CONFIG_ARCH_MX6=y
CONFIG_TARGET_MX6QRSB4411A1_1G=y
CONFIG_VIDEO=y
CONFIG_SYS_EXTRA_OPTIONS="IMX_CONFIG=board/freescale/mx6advantech/mx6qrsb4411a1_4x_MT41K128M16JT-125_1410022609-01.cfg,MX6Q,SYS_USE_SPINOR,ANDROID_SUPPORT"
CONFIG_EFI_PARTITION=y
CONFIG_BOOTDELAY=0
# CONFIG_CONSOLE_MUX is not set
CONFIG_SYS_CONSOLE_IS_IN_ENV=y
CONFIG_SYS_CONSOLE_OVERWRITE_ROUTINE=y
CONFIG_HUSH_PARSER=y
CONFIG_CMD_BOOTZ=y
# CONFIG_CMD_IMLS is not set
# CONFIG_CMD_FLASH is not set
CONFIG_CMD_MMC=y
CONFIG_CMD_SF=y
CONFIG_CMD_I2C=y
CONFIG_CMD_USB=y
CONFIG_CMD_CACHE=y
CONFIG_CMD_EXT2=y
CONFIG_CMD_EXT4=y
CONFIG_CMD_EXT4_WRITE=y
CONFIG_CMD_FAT=y
CONFIG_CMD_FS_GENERIC=y
CONFIG_USB=y
CONFIG_USB_STORAGE=y

# CONFIG_VIDEO_SW_CURSOR is not set
CONFIG_OF_LIBFDT=y
CONFIG_DEFAULT_DEVICE_TREE="imx6q-advantech"
CONFIG_OF_CONTROL=y
CONFIG_ENV_IS_IN_MMC=y
CONFIG_NOT_UUU_BUILD=y
```

## configs/mx6qrsb6410a2_1G_defconfig
```kconfig
CONFIG_SPL=y
CONFIG_SYS_EXTRA_OPTIONS="IMX_CONFIG=board/freescale/mx6advantech/mx6qrsb6410_4x_IM5ZK77D9PTK-125_1410025137-01.cfg,SPL,MX6Q,SYS_USE_SPINOR"
CONFIG_ARM=y
CONFIG_ARCH_MX6=y
CONFIG_TARGET_MX6RSB6410A2_1G=y
CONFIG_CMD_GPIO=y
```

## configs/mx6qrsb6410a2android_1G_defconfig
```kconfig
CONFIG_SYS_EXTRA_OPTIONS="IMX_CONFIG=board/freescale/mx6advantech/mx6qrsb6410_4x_IM5ZK77D9PTK-125_1410025137-01.cfg,MX6Q,SYS_USE_SPINOR,ANDROID_SUPPORT"
CONFIG_ARM=y
CONFIG_TARGET_MX6RSB6410A2_1G=y
CONFIG_DM=y
CONFIG_DM_THERMAL=y
```

## configs/mx6solorom5420b1_1G_defconfig
```kconfig
CONFIG_SPL=y
CONFIG_SYS_EXTRA_OPTIONS="IMX_CONFIG=board/freescale/mx6advantech/mx6solorom5420b1_2x_IM4G16D3FABG-125_1410025137-01.cfg,SPL,MX6SOLO,SYS_USE_SPINOR,SYS_NOSMP=\"nosmp\""
CONFIG_ARM=y
CONFIG_ARCH_MX6=y
CONFIG_TARGET_MX6ROM5420B1_1G=y
CONFIG_CMD_GPIO=y
```

## configs/mx6solorom5420b1_512M_defconfig
```kconfig
CONFIG_SPL=y
CONFIG_SYS_EXTRA_OPTIONS="IMX_CONFIG=board/freescale/mx6advantech/mx6solorom5420b1_4x_MT41K128M16JT-125_1410022609-01.cfg,SPL,MX6SOLO,SYS_USE_SPINOR,SYS_NOSMP=\"nosmp\""
CONFIG_ARM=y
CONFIG_TARGET_MX6ROM5420B1_512M=y
CONFIG_SYS_MALLOC_F=y
CONFIG_SYS_MALLOC_F_LEN=0x400
CONFIG_DM=y
CONFIG_DM_THERMAL=y
```

## configs/mx6solorom7421a1_512M_defconfig
```kconfig
CONFIG_SPL=y
CONFIG_SYS_EXTRA_OPTIONS="IMX_CONFIG=board/freescale/mx6advantech/mx6solorom7421a1_2x_MT41K128M16JT-125_1410022609-01.cfg,SPL,MX6SOLO,SYS_USE_SPINOR,SYS_NOSMP=\"nosmp\""
CONFIG_ARM=y
CONFIG_ARCH_MX6=y
CONFIG_TARGET_MX6ROM7421A1_512M=y
CONFIG_CMD_GPIO=y
```

## configs/mx7debcrm01a1_2G_IM_defconfig
```kconfig
CONFIG_ARM=y
CONFIG_ARCH_MX7=y
CONFIG_TARGET_MX7DEBCRM01A1_2G=y
CONFIG_IMX_RDC=y
CONFIG_IMX_BOOTAUX=y
CONFIG_SYS_EXTRA_OPTIONS="IMX_CONFIG=board/freescale/mx7dadvantech/EBC-RM01_DDR3L_2GB_2rank_IM4G16D3FABG-125I_20180919_v1_2.cfg,SYS_BOOT_QSPI"
CONFIG_CMD_GPIO=y
CONFIG_CMD_DHCP=y
CONFIG_CMD_PING=y
```
