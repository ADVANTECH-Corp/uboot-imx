## arch/arm/mach-imx/imx8m/Kconfig
```kconfig
if ARCH_IMX8M

config IMX8M
	bool
	select HAS_CAAM
	select ROM_UNIFIED_SECTIONS

config IMX8MQ
	bool
	select IMX8M

config IMX8MM
	bool
	select IMX8M

choice
	prompt	"NXP i.MX8M board select"
	optional

config TARGET_IMX8MQ_EVK
	bool "imx8mq_evk"
	select IMX8MQ
	select SUPPORT_SPL
	select IMX8M_LPDDR4

config TARGET_IMX8MQ_DDR3L_ARM2
	bool "imx8mq_ddr3l_arm2"
	select IMX8MQ
	select SUPPORT_SPL

config TARGET_IMX8MQ_DDR4_ARM2
	bool "imx8mq_ddr4_arm2"
	select IMX8MQ
	select SUPPORT_SPL

config TARGET_IMX8MQ_PHANBELL
	bool "imx8mq_phanbell"
	select IMX8MQ
	select SUPPORT_SPL

config TARGET_IMX8MQ_AIY
	bool "imx8mq_aiy"
	select IMX8MQ
	select SUPPORT_SPL
	select IMX8M_LPDDR4

config TARGET_IMX8MM_DDR4_VAL
	bool "imx8mm DDR4 validation board"
	select IMX8MM
	select SUPPORT_SPL

config TARGET_IMX8MM_DDR3L_VAL
	bool "imx8mm DDR3L validation board"
	select IMX8MM
	select SUPPORT_SPL

config TARGET_IMX8MM_EVK
	bool "imx8mm LPDDR4 EVK board"
	select IMX8MM
	select SUPPORT_SPL
	select IMX8M_LPDDR4

config TARGET_IMX8MM_DDR4_EVK
	bool "imx8mm DDR4 EVK board"
	select IMX8MM
	select SUPPORT_SPL
	select IMX8M_DDR4

config TARGET_IMX8MM_ROM5721A1_2G
	bool "imx8mm rom5721a1 2G"
	select IMX8MM
	select SUPPORT_SPL
	select IMX8M_LPDDR4

config TARGET_IMX8MM_ROM5721A1_1G
	bool "imx8mm rom5721a1 1G"
	select IMX8MM
	select SUPPORT_SPL
	select IMX8M_LPDDR4

config TARGET_IMX8MQ_ROM5720A1_2G
	bool "imx8mq rom5720a1 2G"
	select IMX8MQ
	select SUPPORT_SPL
	select IMX8M_LPDDR4

endchoice

config SYS_SOC
	default "imx8m"

source "board/freescale/imx8mq_evk/Kconfig"
source "board/freescale/imx8mq_arm2/Kconfig"
source "board/freescale/imx8mq_phanbell/Kconfig"
source "board/freescale/imx8mq_aiy/Kconfig"
source "board/freescale/imx8mm_evk/Kconfig"
source "board/freescale/imx8mm_val/Kconfig"
source "board/freescale/imx8mq_rom5720a1/Kconfig"
source "board/freescale/imx8mm_rom5721a1/Kconfig"

endif
```

## arch/arm/mach-imx/imx8m/Kconfig.rej
```kconfig
--- arch/arm/mach-imx/imx8m/Kconfig
+++ arch/arm/mach-imx/imx8m/Kconfig
@@ -202,5 +214,6 @@ source "board/freescale/imx8mp_evk/Kconfig"
 source "board/toradex/verdin-imx8mm/Kconfig"
 source "board/freescale/imx8mp_rsb3720a1/Kconfig"
 source "board/freescale/imx8mm_rom5721a1/Kconfig"
+source "board/freescale/imx8mm_ebcrs08a1/Kconfig"
 
 endif
```

## arch/arm/mach-imx/imx9/Kconfig
```kconfig
if ARCH_IMX9

config AHAB_BOOT
    bool "Support i.MX9 AHAB features"
    help
    This option enables the support for AHAB secure boot.

config IMX9
	bool
	select HAS_CAAM
	select ROM_UNIFIED_SECTIONS

config IMX93
	bool
	select IMX9
	select ARMV8_SPL_EXCEPTION_VECTORS
	select SYS_FSL_ERRATUM_ESDHC111

config SYS_SOC
	default "imx9"

choice
	prompt  "NXP i.MX9 board select"
	optional

config TARGET_IMX93_14X14_EVK
	bool "imx93_14x14_evk"
	select IMX93

config TARGET_IMX93_11X11_EVK
	bool "imx93_11x11_evk"
	select IMX93

config TARGET_IMX93_9X9_QSB
	bool "imx93_9x9_qsb"
	select IMX93
	select IMX9_LPDDR4X

config TARGET_IMX91P_11X11_EVK
	bool "imx91p_11x11_evk"
	select IMX93

config TARGET_IMX91P_9X9_QSB
	bool "imx91p_9x9_qsb"
	select IMX93
	select IMX9_LPDDR4X

config TARGET_IMX93_ROM2820A1
	bool "Support i.MX93 ROM2820A1"
	select IMX93
	select SUPPORT_SPL
	select IMX93_DRAM
	#select FSL_CAAM
	#select FSL_BLOB
	select ARCH_MISC_INIT
	select SPL_CRYPTO if SPL

config TARGET_IMX93_AFEE320A1
	bool "Support i.MX93 AFEE320A1"
	select IMX93

endchoice

source "board/advantech/imx93_rom2820a1/Kconfig"
source "board/advantech/imx93_afee320a1/Kconfig"
source "board/freescale/imx93_evk/Kconfig"
source "board/freescale/imx93_qsb/Kconfig"

endif
```

## board/advantech/imx8mm_ebcrs08a2/Kconfig
```kconfig
if TARGET_IMX8MM_EBCRS08A2_2G || TARGET_IMX8MM_EBCRS08A2_1G
config SYS_BOARD
	default "imx8mm_ebcrs08a2"

config SYS_VENDOR
	default "advantech"

config SYS_CONFIG_NAME
	default "imx8mm_ebcrs08"

config IMX_CONFIG
	default "board/advantech/imx8mm_ebcrs08a2/imximage-8mm.cfg"

config IMX8M_1G_MEMORY
	bool "imx8m 1GB memory size"

source "board/advantech/common/Kconfig"

endif
```

## board/advantech/imx8mm_rom5721a1/Kconfig
```kconfig
if TARGET_IMX8MM_ROM5721A1_1G || TARGET_IMX8MM_ROM5721A1_2G

config SYS_BOARD
	default "imx8mm_rom5721a1"

config SYS_VENDOR
	default "advantech"

config SYS_CONFIG_NAME
	default "imx8mm_rom5721"

config IMX_CONFIG
	default "board/advantech/imx8mm_rom5721a1/imximage-8mm.cfg"

config IMX8M_1G_MEMORY
	bool "imx8m 1GB memory size"

source "board/advantech/common/Kconfig"

endif
```

## board/advantech/imx8mp_epcr5710a1/Kconfig
```kconfig
if TARGET_IMX8MP_EPCR5710A1_6G || TARGET_IMX8MP_EPCR5710A1_4G || TARGET_IMX8MP_EPCR5710A1_2G

config SYS_BOARD
	default "imx8mp_epcr5710a1"

config SYS_VENDOR
	default "advantech"

config SYS_CONFIG_NAME
	default "imx8mp_epcr5710"

config IMX_CONFIG
	default "board/advantech/imx8mp_epcr5710a1/imximage-8mp-lpddr4.cfg"

source "board/advantech/common/Kconfig"

endif
```

## board/advantech/imx8mp_rom5722a1/Kconfig
```kconfig
if TARGET_IMX8MP_ROM5722A1_6G

config SYS_BOARD
	default "imx8mp_rom5722a1"

config SYS_VENDOR
	default "advantech"

config SYS_CONFIG_NAME
	default "imx8mp_rom5722"

config IMX_CONFIG
	default "board/advantech/imx8mp_rom5722a1/imximage-8mp-lpddr4.cfg"

endif
```

## board/advantech/imx8mp_rsb3720a1/Kconfig
```kconfig
if TARGET_IMX8MP_RSB3720A1_6G || TARGET_IMX8MP_RSB3720A1_4G || TARGET_IMX8MP_RSB3720A1_2G

config SYS_BOARD
	default "imx8mp_rsb3720a1"

config SYS_VENDOR
	default "advantech"

config SYS_CONFIG_NAME
	default "imx8mp_rsb3720"

config IMX_CONFIG
	default "board/advantech/imx8mp_rsb3720a1/imximage-8mp-lpddr4.cfg"

source "board/advantech/common/Kconfig"

endif
```

## board/advantech/imx8mp_rsb3720a2/Kconfig
```kconfig
if TARGET_IMX8MP_RSB3720A2_6G

config SYS_BOARD
	default "imx8mp_rsb3720a2"

config SYS_VENDOR
	default "advantech"

config SYS_CONFIG_NAME
	default "imx8mp_rsb3720"

config IMX_CONFIG
	default "board/advantech/imx8mp_rsb3720a2/imximage-8mp-lpddr4.cfg"

source "board/advantech/common/Kconfig"

endif
```

## board/advantech/imx8mq_rom5720a1/Kconfig
```kconfig
if TARGET_IMX8MQ_ROM5720A1_2G

config SYS_BOARD
	default "imx8mq_rom5720a1"

config SYS_VENDOR
	default "advantech"

config SYS_CONFIG_NAME
	default "imx8mq_rom5720"

source "board/advantech/common/Kconfig"

endif
```

## board/advantech/imx8ulp_rom2620a1/Kconfig
```kconfig
if TARGET_IMX8ULP_ROM2620A1_2G || TARGET_IMX8ULP_ROM2620A1_1G

config SYS_BOARD
	default "imx8ulp_rom2620a1"

config SYS_VENDOR
	default "advantech"

config SYS_CONFIG_NAME
	default "imx8ulp_rom2620"

source "board/advantech/common/Kconfig"

endif
```

## board/advantech/imx95_aom3511a1/Kconfig
```kconfig
if TARGET_IMX95_AOM3511A1

config SYS_BOARD
	default "imx95_aom3511a1"

config SYS_VENDOR
	default "advantech"

config SYS_CONFIG_NAME
	default "imx95_aom3511"

endif
```

## board/freescale/imx8mm_ebcrs08a1/Kconfig
```kconfig
if TARGET_IMX8MM_EBCRS08A1_2G || TARGET_IMX8MM_EBCRS08A1_1G
config SYS_BOARD
        default "imx8mm_ebcrs08a1"

config SYS_VENDOR
        default "freescale"

config SYS_CONFIG_NAME
        default "imx8mm_ebcrs08"

source "board/freescale/common/Kconfig"

endif
```

## board/freescale/imx8mm_ebcrs08a2/Kconfig
```kconfig
if TARGET_IMX8MM_EBCRS08A2_2G || TARGET_IMX8MM_EBCRS08A2_1G
config SYS_BOARD
        default "imx8mm_ebcrs08a2"

config SYS_VENDOR
        default "freescale"

config SYS_CONFIG_NAME
        default "imx8mm_ebcrs08"

source "board/freescale/common/Kconfig"

endif
```

## board/freescale/imx8mm_rom5721a1/Kconfig
```kconfig
if TARGET_IMX8MM_ROM5721A1_2G || TARGET_IMX8MM_ROM5721A1_1G
config SYS_BOARD
        default "imx8mm_rom5721a1"

config SYS_VENDOR
        default "freescale"

config SYS_CONFIG_NAME
        default "imx8mm_rom5721"

source "board/freescale/common/Kconfig"

endif
```

## board/freescale/imx8mm_rsb3730/Kconfig
```kconfig
if TARGET_IMX8MM_RSB3730A1_2G || TARGET_IMX8MM_RSB3730A2_2G || TARGET_IMX8MM_RSB3730A2_4G
config SYS_BOARD
        default "imx8mm_rsb3730"

config SYS_VENDOR
        default "freescale"

config SYS_CONFIG_NAME
        default "imx8mm_rsb3730"

source "board/freescale/common/Kconfig"

endif
```

## board/freescale/imx8mp_epcr5710a1/Kconfig
```kconfig
if TARGET_IMX8MP_EPCR5710A1_6G || TARGET_IMX8MP_EPCR5710A1_4G|| TARGET_IMX8MP_EPCR5710A1_2G

config SYS_BOARD
	default "imx8mp_epcr5710a1"

config SYS_VENDOR
	default "freescale"

config SYS_CONFIG_NAME
	default "imx8mp_epcr5710"

source "board/freescale/common/Kconfig"

endif
```

## board/freescale/imx8mp_rm02a1/Kconfig
```kconfig
if TARGET_IMX8MP_RM02A1_6G || TARGET_IMX8MP_RM02A1_4G || TARGET_IMX8MP_RM02A1_2G

config SYS_BOARD
	default "imx8mp_rm02a1"

config SYS_VENDOR
	default "freescale"

config SYS_CONFIG_NAME
	default "imx8mp_rm02"

source "board/freescale/common/Kconfig"

endif
```

## board/freescale/imx8mp_rom5722a1/Kconfig
```kconfig
if TARGET_IMX8MP_ROM5722A1_6G || TARGET_IMX8MP_ROM5722A1_4G || TARGET_IMX8MP_ROM5722A1_2G

config SYS_BOARD
	default "imx8mp_rom5722a1"

config SYS_VENDOR
	default "freescale"

config SYS_CONFIG_NAME
	default "imx8mp_rom5722"

source "board/freescale/common/Kconfig"

endif
```

## board/freescale/imx8mq_advantech/Kconfig
```kconfig
config SYS_BOARD
	default "imx8mq_advantech"

config SYS_VENDOR
	default "freescale"

if TARGET_IMX8MQ_ROM5720A1_2G

config SYS_CONFIG_NAME
	default "imx8mq_rom5720"

source "board/freescale/common/Kconfig"

endif
```

## board/freescale/imx8qxp_rom3620a1/Kconfig
```kconfig
if TARGET_IMX8QXP_ROM3620A1_2G

config SYS_BOARD
	default "imx8qxp_rom3620a1"

config SYS_VENDOR
	default "freescale"

config SYS_CONFIG_NAME
	default "imx8qxp_rom3620"

source "board/freescale/common/Kconfig"

endif
```

## board/freescale/imx8qxp_rom5620a1/Kconfig
```kconfig
if TARGET_IMX8QXP_ROM5620A1_2G || TARGET_IMX8QXP_ROM5620A1_4G

config SYS_BOARD
	default "imx8qxp_rom5620a1"

config SYS_VENDOR
	default "freescale"

config SYS_CONFIG_NAME
	default "imx8qxp_rom5620"

source "board/freescale/common/Kconfig"

endif
```

## board/freescale/mx6advantech/Kconfig
```kconfig
config SYS_BOARD
	default "mx6advantech"

config SYS_VENDOR
	default "freescale"

config SYS_TEXT_BASE
	default 0x26800000

if TARGET_MX6QRSB4411A1_1G
config SYS_CONFIG_NAME
	default "mx6rsb4411"
endif
```

## board/freescale/mx7dadvantech/Kconfig
```kconfig
config SYS_BOARD
	default "mx7dadvantech"

config SYS_VENDOR
	default "freescale"

if TARGET_MX7DEBCRM01A1_2G

config SYS_CONFIG_NAME
	default "mx7debcrm01"

endif
```

## configs/mx6dlebcrs03a1_1G_defconfig
```kconfig
CONFIG_SPL=y
CONFIG_SYS_EXTRA_OPTIONS="IMX_CONFIG=board/freescale/mx6advantech/mx6dlubc220a1_4x_K4B2G1646Q-BCK0_1410024420-01.cfg,SPL,MX6DL,SYS_USE_SPINOR"
CONFIG_ARM=y
CONFIG_ARCH_MX6=y
CONFIG_TARGET_MX6EBCRS03A1_1G=y
CONFIG_CMD_GPIO=y
```
